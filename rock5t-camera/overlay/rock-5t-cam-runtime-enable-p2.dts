/dts-v1/;
/plugin/;

/*
 * Runtime enable of the ROCK 5T camera pipeline (dual IMX477) — PHASE 2.
 *
 * Applied by rk_cam_defer_enable.ko ~200ms after phase 1
 * (rock-5t-cam-runtime-enable.dts — see its header for the full design).
 * Enabling the D-PHYs last triggers the sensor match and lets the async
 * completion cascade run with the sditf bridges already attached.
 */

/ {
	fragment@0 {
		target-path = "/csi2-dphy0";
		__overlay__ { status = "okay"; };
	};

	fragment@1 {
		target-path = "/csi2-dphy4";
		__overlay__ { status = "okay"; };
	};
};
